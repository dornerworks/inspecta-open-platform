/dts-v1/;

/include/ "linux.dtsi"

/ {
	chosen {
		// bootargs = "console=ttyPS1,115200n8 root=/dev/ram0 maxcpus=1 nosmp clk_ignore_unused earlycon debug loglevel=8";
		// stdout-path = "serial1:115200n8";
		bootargs = "console=ttyPS0,115200 root=/dev/ram0 maxcpus=1 nosmp clk_ignore_unused earlycon debug loglevel=8";
		stdout-path = "serial0:115200n8";
		#size-cells = <0x02>;
		linux,initrd-start = <0x08 0x20010000>;
		linux,initrd-end = <0x08 0x20B27FF0>;
	};

	memory@0 {
		device_type = "memory";
		reg = <0x08 0x10000000 0x00 0x20000000>;
	};
};

&serial0 {
	status = "okay";
};
// &serial1 {
// 	status = "okay";
// };
